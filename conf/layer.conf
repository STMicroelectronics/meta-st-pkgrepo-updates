## conf/layer.conf
```bitbake
# We have a conf and classes directory, add to BBPATH
BBPATH .= ":${LAYERDIR}"

# We have recipes-* directories, add to BBFILES
BBFILES += "${LAYERDIR}/recipes-*/*/*.bb \
            ${LAYERDIR}/recipes-*/*/*.bbappend"

BBFILE_COLLECTIONS += "st-pkgrepo-updates"
BBFILE_PATTERN_st-pkgrepo-updates = "^${LAYERDIR}/"
BBFILE_PRIORITY_st-pkgrepo-updates = "5"

LAYERDEPENDS_st-pkgrepo-updates = "st-openstlinux jupyter-layer"

LAYERSERIES_COMPAT_st-pkgrepo-updates = "mickledore"
LAYERVERSION_st-pkgrepo-updates = "1"

INHERIT += "check-st-openstlinux-compatibility"

# OpenSTLinux compatibility version
ST_OSTL_COMPATIBILITY_VERSION_st-openstlinux = "5.1"
```
